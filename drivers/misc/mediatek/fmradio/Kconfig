## drivers/misc/mediatek/fmradio/Kconfig
```kconfig
config MTK_FMRADIO
  bool CONFIG_MTK_FMRADIO
  default n
  help
    CONFIG_MTK_FMRADIO

config MTK_FMRADIO_SHORT_ANTENNA
  bool CONFIG_MTK_FMRADIO_SHORT_ANTENNA
  default n
  help
    CONFIG_MTK_FMRADIO_SHORT_ANTENNA
```
